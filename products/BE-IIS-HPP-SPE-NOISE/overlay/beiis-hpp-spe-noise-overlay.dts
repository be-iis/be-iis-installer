// SPDX-License-Identifier: GPL-2.0-only
/dts-v1/;
/plugin/;
/ {
	compatible = "brcm,bcm2835";
	fragment@0 {
		target = <&i2c1>;
		__overlay__ {
			#address-cells = <1>;
			#size-cells = <0>;
			status = "okay";
			noise: noise-generator@2a {
				compatible = "be-iis,hpp-spe-noise";
				reg = <0x2a>;
				status = "okay";
			};
		};
	};
	__overrides__ { addr = <&noise>, "reg:0"; };
};
