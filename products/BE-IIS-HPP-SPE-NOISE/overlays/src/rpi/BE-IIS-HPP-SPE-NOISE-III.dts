// SPDX-License-Identifier: GPL-2.0-only
/dts-v1/;
/plugin/;
/ {
	compatible = "brcm,bcm2835";
	fragment@0 {
		target = <&i2c1>;
		__overlay__ {
			#address-cells = <1>;
			#size-cells = <0>;
			status = "okay";
			noise_iii: noise-generator@28 {
				compatible = "be-iis,hpp-spe-noise";
				reg = <0x28>;
				status = "okay";
			};
		};
	};
};
